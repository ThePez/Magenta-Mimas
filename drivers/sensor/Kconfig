## drivers/sensor/xiao_battery/Kconfig
```kconfig
config XIAO_BATTERY
    bool "XIAO battery sensor"
    default n
    depends on DT_HAS_XIAO_BATTERY_ENABLED && SENSOR && ADC
    help
        Enable driver for Seeeduino XIAO battery sensor.
```

## dts/bindings/xiao,battery.yaml
```yaml
description: Seeeduino XIAO nRF52840 BLE battery sensor.

compatible: "xiao,battery"
include: sensor-device.yaml

properties:
  io-channels:
    required: true
    description: ADC channel for battery voltage reading
  
  sampling-time:
    type: int
    required: true
    description: Sampling time for sensor in seconds.

  read-gpios:
    type: phandle-array
    required: true
    description: GPIO pin for enabling reading.
```
