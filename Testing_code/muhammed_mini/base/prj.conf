## CMakeLists.txt
```
# SPDX-License-Identifier: Apache-2.0

cmake_minimum_required(VERSION 3.20.0)
find_package(Zephyr REQUIRED HINTS $ENV{ZEPHYR_BASE})
project(base_node)

FILE(GLOB app_sources src/*.c)
target_sources(app PRIVATE
    ${app_sources}
)
```

## prj.conf
```kconfig
CONFIG_MAIN_STACK_SIZE=4096
CONFIG_STACK_USAGE=y

CONFIG_BT=y
CONFIG_BT_OBSERVER=y
CONFIG_BT_CENTRAL=y
CONFIG_BT_GATT_CLIENT=y

CONFIG_BT_SMP=y
CONFIG_BT_MAX_CONN=3

CONFIG_BT_USER_DATA_LEN_UPDATE=y
CONFIG_BT_CTLR_DATA_LENGTH_MAX=251
CONFIG_BT_BUF_ACL_RX_SIZE=251
CONFIG_BT_BUF_ACL_TX_SIZE=251
CONFIG_BT_L2CAP_TX_MTU=247

CONFIG_SHELL=y
CONFIG_DATE_SHELL=y

CONFIG_SHELL_MINIMAL=y
CONFIG_SHELL_ECHO_STATUS=n
CONFIG_SHELL_PROMPT_UART=""
CONFIG_BOOT_BANNER=n

CONFIG_CBPRINTF_FP_SUPPORT=y

CONFIG_JSON_LIBRARY=y
```

## src/main.c
```c
/* ============================================================== */
/* Main file - contains all the shell commands                    */
/* Written: Muhammed A                                            */
/* ============================================================== */

#include "location.h"
#include "nus.h"
#include "sniffer.h"

#include <zephyr/bluetooth/bluetooth.h>
#include <zephyr/kernel.h>
#include <zephyr/shell/shell.h>

/* ========================================================================== */
/* Scanning                                                                   */
/* ========================================================================== */

// Just a bunch of shell command handlers..
static int handle_sniff_change(const struct shell *sh, bool sniffing)
{
    shell_print(sh, "L: Sniffing mode set to: %s",
                sniffing ? "Enabled" : "Disabled");
    atomic_set(&sniffer_active, sniffing);
    return 0;
}

static int cmd_sniff_start(const struct shell *sh, size_t argc, char **argv)
{
    bool current_mode = atomic_get(&sniffer_active);
    if (current_mode) {
        shell_error(sh, "L: Already sniffing!");
        return -EINVAL;
    }

    return handle_sniff_change(sh, true);
}

static int cmd_sniff_stop(const struct shell *sh, size_t argc, char **argv)
{
    bool current_mode = atomic_get(&sniffer_active);
    if (!current_mode) {
        shell_error(sh, "L: Sniffing already stopped!");
        return -EINVAL;
    }

    return handle_sniff_change(sh, false);
}

static int cmd_sniff_toggle(const struct shell *sh, size_t argc, char **argv)
{
    return handle_sniff_change(sh, !atomic_get(&sniffer_active));
}

/* ========================================================================== */
/* Ibeacon Shell Commands                                                     */
/* ========================================================================== */

static int cmd_ibeacon_add(const struct shell *sh, size_t argc, char **argv)
{
    char *beacon = argv[1];

    if (!beacon) {
        shell_error(sh, "L: No item found!");
        return 1;
    }

    int beacon_index = beacon[0];

    if (beacon_index < 'A' || beacon_index >= 'N') {
        shell_error(sh, "L: Give a valid beacon!");
        return 1;
    }

    return add_beacon(beacon_index);
}

static int cmd_ibeacon_add_arb(const struct shell *sh, size_t argc, char **argv)
{
    const char* empty = "";
    struct iBeacon_info info;

    if (strlen(argv[1]) > MAX_NAME_LEN) {
        shell_error(sh, "L: Name must be 30 or less characters");
        return 1;
    }
    info.name = argv[1];

    // WE can use this function to check if the address given is in the wright
    // format, it will return false if not.
    bt_addr_t addr;
    if (bt_addr_from_str(argv[2], &addr)) {
        shell_error(sh, "L: Address is not well formed!");
        return 2;
    }
    info.address = argv[2];

    char* endptr;

    info.major = strtol(argv[3], &endptr, 10);
    if (endptr == argv[3] || info.major > 65535 || info.major < 0) {
        shell_error(sh, "L: Major must be a 16-bit number");
        return 3;
    }

    info.minor = strtol(argv[4], &endptr, 10);
    if (endptr == argv[4] || info.minor > 65535 || info.minor < 0) {
        shell_error(sh, "L: Minor must be a 16-bit number");
        return 3;
    }

    info.x = strtol(argv[5], &endptr, 10);
    if (endptr == argv[5]) {
        shell_error(sh, "L: X must be a number");
        return 3;
    }

    info.y = strtol(argv[6], &endptr, 10);
    if (endptr == argv[6]) {
        shell_error(sh, "L: Y must be a number");
        return 3;
    }

    // I hate data parsing...

    if (argc == 9) {
        if (strlen(argv[7]) > MAX_NAME_LEN || strlen(argv[8]) > MAX_NAME_LEN) {
            shell_error(sh, "L: Name must be 30 or less characters");
            return 1;
        }

        info.left_name = argv[7];
        info.right_name = argv[8];
    } else {
        info.left_name = (char*) empty;
        info.right_name = (char*) empty;
    }

    return add_arbitrary_beacon(&info);
}

static int cmd_ibeacon_remove(const struct shell *sh, size_t argc, char **argv)
{
    char *beacon = argv[1];

    if (!beacon) {
        shell_error(sh, "L: No item found!");
        return 1;
    }

    int beacon_index = beacon[0];

    if (beacon_index < 'A' || beacon_index >= 'N') {
        shell_error(sh, "L: Give a valid beacon!");
        return 1;
    }

    return remove_beacon(beacon_index);
}

static int cmd_ibeacon_remove_arb(const struct shell *sh, size_t argc,
                                  char **argv)
{
    char *address = argv[1];
    bt_addr_t addr;

    if (bt_addr_from_str(address, &addr)) {
        shell_error(sh, "L: Address is not well formed!");
        return -1;
    }

    return remove_arbitrary_beacon(address);
}

static int cmd_ibeacon_list(const struct shell *sh, size_t argc, char **argv)
{
    if (list_beacons()) {
        shell_error(sh, "L: Could not list beacons for some reason");
        return -1;
    }

    return 0;
}

SHELL_STATIC_SUBCMD_SET_CREATE(
    sniffer_cmds, SHELL_CMD(start, NULL, "Start sniffing", cmd_sniff_start),
    SHELL_CMD(stop, NULL, "Stop sniffing", cmd_sniff_stop),
    SHELL_CMD(toggle, NULL, "Toggle sniffing", cmd_sniff_toggle),
    SHELL_SUBCMD_SET_END);

SHELL_STATIC_SUBCMD_SET_CREATE(
    ibeacon_cmds,
    SHELL_CMD_ARG(add, NULL,
                  "Add an iBeacon Node\n"
                  "Usage: ibeacon add <node>",
                  cmd_ibeacon_add, 2, 0),
    SHELL_CMD_ARG(add_arb, NULL,
                  "Add an arbitrary beacon\n"
                  "Usage: ibeacon add_arb <name> <address> <major> <minor> <x> "
                  "<y> [left_name] [right_name]",
                  cmd_ibeacon_add_arb, 7, 2),
    SHELL_CMD_ARG(remove, NULL,
                  "Remove an iBeacon Node\n"
                  "Usage: ibeacon remove <node>",
                  cmd_ibeacon_remove, 2, 0),
    SHELL_CMD_ARG(remove_arb, NULL,
                  "Remove an arbitary beacon\n"
                  "Usage: ibeacon remove <address>",
                  cmd_ibeacon_remove_arb, 2, 0),
    SHELL_CMD(list, NULL, "List all iBeacon Nodes", cmd_ibeacon_list),
    SHELL_SUBCMD_SET_END);

SHELL_CMD_REGISTER(sniffer, &sniffer_cmds, "Sniffer Commands", NULL);
SHELL_CMD_REGISTER(ibeacon, &ibeacon_cmds, "iBeacon Commands", NULL);

/* ==========================================================================
 * Main
 * ========================================================================== */

int main(void)
{
    int err = bt_enable(NULL);
    if (err) {
        return err;
    }

    initialise_multilateration();
    start_scan();

    return 0;
}
```

## src/beacons.c
```c
/* ========================================================================== */
/* iBeacons Source                                                            */
/* Written: Muhammed A                                                        */
/* ========================================================================== */

#include "beacons.h"

#include <zephyr/kernel.h>

/* ========================================================================== */
/* Memory management                                                          */
/* ========================================================================== */

#define MUTEX_TIMEOUT_MS 100
#define JSON_BUFFER_SIZE 256
#define HEAP_SIZE        8192

// Only slist_iBeacon needs the mutex
sys_slist_t slist_iBeacon;
sys_slist_t slist_iBeacon_arbitrary;

K_MUTEX_DEFINE(beacons_mutex);

K_HEAP_DEFINE(beacons_heap, HEAP_SIZE);

/* ========================================================================== */
/* Default beacon setup                                                       */
/* ========================================================================== */

static void free_iBeacon_info(struct iBeacon_info *info)
{
    k_heap_free(&beacons_heap, info->name);
    k_heap_free(&beacons_heap, info->address);
    k_heap_free(&beacons_heap, info->left_name);
    k_heap_free(&beacons_heap, info->right_name);
    k_heap_free(&beacons_heap, info);
}

static void free_iBeacon_data(struct iBeacon_data *beacon)
{
    free_iBeacon_info(beacon->info);
    k_heap_free(&beacons_heap, beacon);
}

// This is used at the beginning of the program to make a beacon and copy over
// the initial data defined in beacons.h
static bool make_default_beacon(int index)
{
    // Type should be between 0 and MAX_BEACON_COUNT
    struct iBeacon_data *data =
        k_heap_alloc(&beacons_heap, sizeof(struct iBeacon_data), K_NO_WAIT);

    if (data == NULL) {
        printk("L: Error allocating memory!\n");
        return false;
    }

    data->info =
        k_heap_alloc(&beacons_heap, sizeof(struct iBeacon_info), K_NO_WAIT);

    if (!(data->info)) {
        k_heap_free(&beacons_heap, data);
        printk("L: Error allocating memory!\n");
        return false;
    }

    memset(&data->node, 0, sizeof(sys_snode_t));

    data->info->major = majors_init[index];
    data->info->minor = minors_init[index];
    data->info->x = xs_init[index];
    data->info->y = ys_init[index];

    data->distance = 0;

    data->info->address =
        k_heap_alloc(&beacons_heap, ADDRESS_BUFFER_LEN, K_NO_WAIT);
    data->info->name =
        k_heap_alloc(&beacons_heap, NAME_INITIAL_BUFFER_LEN, K_NO_WAIT);
    data->info->left_name =
        k_heap_alloc(&beacons_heap, NAME_INITIAL_BUFFER_LEN, K_NO_WAIT);
    data->info->right_name =
        k_heap_alloc(&beacons_heap, NAME_INITIAL_BUFFER_LEN, K_NO_WAIT);

    if (!data->info->name && !data->info->left_name &&
        !data->info->right_name && !data->info->address) {
        free_iBeacon_data(data);
        printk("L: Failed to allocate memory\n");
        return false;
    }

    strcpy(data->info->address, addresses_init[index]);
    strcpy(data->info->name, name_init);
    strcpy(data->info->left_name, name_init);
    strcpy(data->info->right_name, name_init);

    // Change the letter of the left and right names (simple circular)
    data->info->name[5] += index;
    data->info->right_name[5] +=
        ((MAX_BEACON_COUNT + index + 1) % MAX_BEACON_COUNT);
    data->info->left_name[5] +=
        ((MAX_BEACON_COUNT + index - 1) % MAX_BEACON_COUNT);

    sys_slist_append(&slist_iBeacon, &(data->node));

    return true;
}

int initialise_beacons()
{
    if (k_mutex_lock(&beacons_mutex, K_MSEC(100)) != 0) {
        printk("L: Mutex not unlocking!\n");
        return -1;
    }

    // Initialise singly linked list containing iBeacon
    sys_slist_init(&slist_iBeacon);
    sys_slist_init(&slist_iBeacon_arbitrary);

    for (int i = 0; i < MAX_BEACON_COUNT; i++) {
        if (!make_default_beacon(i)) {
            k_mutex_unlock(&beacons_mutex);
            return -1;
        }
    }

    k_mutex_unlock(&beacons_mutex);
    return 0;
}

// Add a beacon out of the 13 given its character 
int add_beacon(char name)
{
    if (k_mutex_lock(&beacons_mutex, K_MSEC(MUTEX_TIMEOUT_MS)) != 0) {
        printk("L: Mutex not unlocking!\n");
        return -1;
    }

    int cur_beacon = sys_slist_len(&slist_iBeacon);

    struct iBeacon_data *list_node =
        SYS_SLIST_PEEK_HEAD_CONTAINER(&slist_iBeacon, list_node, node);

    if (!list_node) {
        k_mutex_unlock(&beacons_mutex);
        printk("L: Beacons do not exist\n");
        return -1;
    }

    for (int i = 0; i < cur_beacon && list_node != NULL; i++) {
        // Check its letter
        if (list_node->info->name[5] == name) {
            k_mutex_unlock(&beacons_mutex);
            printk("L: Beacon already added!\n");
            return -1;
        }

        list_node = SYS_SLIST_PEEK_NEXT_CONTAINER(list_node, node);
    }

    int res = make_default_beacon(name - 'A');

    k_mutex_unlock(&beacons_mutex);

    if (!res) {
        return -2;
    }

    return 0;
}

// The struct here is supplied from the shell command - that's where the 
// inputs are validated as well. Otherwise it is very similar to how the 
// initial node is validated (except here it is iBeacon_info instead of 
// iBeacon_data)
int add_arbitrary_beacon(struct iBeacon_info *info_args)
{
    // No mutex needed for this one
    if (sys_slist_len(&slist_iBeacon_arbitrary) >= MAX_ARB_COUNT) {
        printk("L: Reached maximum limit of arbitrary beacons!\n");
        return -1;
    }

    struct iBeacon_info *info =
        k_heap_alloc(&beacons_heap, sizeof(struct iBeacon_info), K_NO_WAIT);

    if (!info_args) {
        printk("L: Error allocating memory!\n");
        return -1;
    }

    memset(&info->node, 0, sizeof(sys_snode_t));
    info->major = info_args->major;
    info->minor = info_args->minor;
    info->x = info_args->x;
    info->y = info_args->y;

    info->address = k_heap_alloc(&beacons_heap, ADDRESS_BUFFER_LEN, K_NO_WAIT);
    info->name =
        k_heap_alloc(&beacons_heap, strlen(info_args->name) + 1, K_NO_WAIT);
    info->left_name = k_heap_alloc(&beacons_heap,
                                   strlen(info_args->left_name) + 1, K_NO_WAIT);
    info->right_name = k_heap_alloc(
        &beacons_heap, strlen(info_args->right_name) + 1, K_NO_WAIT);

    if (!info->name && !info->left_name && !info->right_name &&
        !info->address) {
        free_iBeacon_info(info);
        printk("L: Failed to allocate memory\n");
        return -1;
    }

    strcpy(info->address, info_args->address);
    strcpy(info->name, info_args->name);
    strcpy(info->right_name, info_args->right_name);
    strcpy(info->left_name, info_args->left_name);

    sys_slist_append(&slist_iBeacon_arbitrary, &(info->node));

    return 0;
}

// Remove one of the 13 beacons given its character. We impose a limit of 
// 4 beacons minimum for reasons described in location.c
int remove_beacon(char name)
{
    if (k_mutex_lock(&beacons_mutex, K_MSEC(MUTEX_TIMEOUT_MS)) != 0) {
        printk("L: Mutex not unlocking!\n");
        return -1;
    }

    int cur_beacon = sys_slist_len(&slist_iBeacon);

    if (cur_beacon == MULTILATERATION_BEACONS) {
        printk("L: Cannot have less than %d beacons!\n",
               MULTILATERATION_BEACONS);
        k_mutex_unlock(&beacons_mutex);
        return -1;
    }

    struct iBeacon_data *prev = NULL;
    struct iBeacon_data *list_node =
        SYS_SLIST_PEEK_HEAD_CONTAINER(&slist_iBeacon, list_node, node);

    for (int i = 0; i < cur_beacon && list_node != NULL; i++) {
        if (list_node->info->name[5] == name) {
            // You have to give it the previous node to delete, so it's 
            // important to make sure that you're not trying to reference a
            // value within a NULL
            sys_slist_remove(&slist_iBeacon,
                             (prev == NULL) ? NULL : &(prev->node),
                             &(list_node->node));
            free_iBeacon_data(list_node);
            k_mutex_unlock(&beacons_mutex);
            return 0;
        }

        prev = list_node;
        list_node = SYS_SLIST_PEEK_NEXT_CONTAINER(list_node, node);
    }

    k_mutex_unlock(&beacons_mutex);

    printk("L: Beacon already removed\n");
    return -1;
}

// Same as above, except checking addresses.
int remove_arbitrary_beacon(char *address)
{
    int cur_arb = sys_slist_len(&slist_iBeacon_arbitrary);

    if (cur_arb == 0) {
        printk("L: There are no arbitrary beacons!\n");
        return -1;
    }

    struct iBeacon_info *prev = NULL;
    struct iBeacon_info *list_node = SYS_SLIST_PEEK_HEAD_CONTAINER(
        &slist_iBeacon_arbitrary, list_node, node);

    for (int i = 0; i < cur_arb && list_node != NULL; i++) {
        if (strcmp(list_node->address, address) == 0) {
            sys_slist_remove(&slist_iBeacon_arbitrary,
                             (prev == NULL) ? NULL : &(prev->node),
                             &(list_node->node));
            free_iBeacon_info(list_node);
            return 0;
        }

        prev = list_node;
        list_node = SYS_SLIST_PEEK_NEXT_CONTAINER(list_node, node);
    }

    printk("L: Arbitary beacon not added\n");
    return -1;
}

// List both types of beacons - the 13 multilaterative ones as well as the
// non laterative ones. These are sent out with an I/A prefix depending on 
// whether it's an (I)Beacon or an (A)rbitrary bluetooth node.
int list_beacons()
{
    if (k_mutex_lock(&beacons_mutex, K_MSEC(MUTEX_TIMEOUT_MS)) != 0) {
        printk("L: Mutex not unlocking!\n");
        return -1;
    }

    int cur_beacon = sys_slist_len(&slist_iBeacon);
    // No stack overflows here!
    char *json_buffer =
        k_heap_alloc(&beacons_heap, JSON_BUFFER_SIZE, K_NO_WAIT);

    if (json_buffer == NULL) {
        k_mutex_unlock(&beacons_mutex);
        printk("L: Could not free space for beacons!\n");
        return -1;
    }

    struct iBeacon_data *list_node_data =
        SYS_SLIST_PEEK_HEAD_CONTAINER(&slist_iBeacon, list_node_data, node);

    for (int i = 0; i < cur_beacon && list_node_data != NULL; i++) {
        // Send out the beacon data as a JSON as required
        if (json_obj_encode_buf(
                iBeacon_info_descr, ARRAY_SIZE(iBeacon_info_descr),
                list_node_data->info, json_buffer, JSON_BUFFER_SIZE) == 0) {
            printk("I: %s\n", json_buffer);
            k_msleep(1);
        }

        list_node_data = SYS_SLIST_PEEK_NEXT_CONTAINER(list_node_data, node);
    }
 
    // We don't need the mutex to access the arbitary beacons (it's only 
    // accessed from the shell command thread)
    k_mutex_unlock(&beacons_mutex);

    int cur_arb = sys_slist_len(&slist_iBeacon_arbitrary);

    struct iBeacon_info *list_node_info = SYS_SLIST_PEEK_HEAD_CONTAINER(
        &slist_iBeacon_arbitrary, list_node_info, node);

    for (int i = 0; i < cur_arb && list_node_info != NULL; i++) {
        if (json_obj_encode_buf(iBeacon_info_descr,
                                ARRAY_SIZE(iBeacon_info_descr), list_node_info,
                                json_buffer, JSON_BUFFER_SIZE) == 0) {
            printk("A: %s\n", json_buffer);
            k_msleep(1);
        }

        list_node_info = SYS_SLIST_PEEK_NEXT_CONTAINER(list_node_info, node);
    }

    k_heap_free(&beacons_heap, json_buffer);
    return 0;
}
```

## src/beacons.h
```c
/* ============================================================== */
/* Beacons data header                                            */
/* Written: Muhammed A                                            */
/* ============================================================== */

#ifndef BASE_BEACONS_H
#define BASE_BEACONS_H

#include "nus.h"

#include <zephyr/data/json.h>
#include <zephyr/kernel.h>

#define MAX_ARB_COUNT           20
#define MAX_BEACON_COUNT        13
#define MAX_NAME_LEN            30
#define MULTILATERATION_BEACONS 4
#define NAME_INITIAL_BUFFER_LEN 7

#define BEACONS_RSSI_A (-57)
#define BEACONS_RSSI_N 3.2

/* ========================================================================== */
/* iBeacon structures                                                         */
/* ========================================================================== */

// Basically iBeacon_data is used for the beacons that require multilateration.
// iBeacon_info is used for any sort of beacon that is added to the device, and
// an iBeacon_data requires a reference to an existing iBeacon_info node.

struct iBeacon_info {
    sys_snode_t node;

    char *name;
    char *address;

    // Have to be int because of JSON, sadly
    int major;
    int minor;
    int x;
    int y;

    char *left_name; // These can be empty ("") but not NULL
    char *right_name;
};

struct iBeacon_data {
    sys_snode_t node;
    // Just simpler this way when calculating the location...
    struct iBeacon_info *info;
    double distance;
};

static const struct json_obj_descr iBeacon_info_descr[] = {
    JSON_OBJ_DESCR_PRIM(struct iBeacon_info, name, JSON_TOK_STRING),
    JSON_OBJ_DESCR_PRIM(struct iBeacon_info, address, JSON_TOK_STRING),
    JSON_OBJ_DESCR_PRIM(struct iBeacon_info, major, JSON_TOK_NUMBER),
    JSON_OBJ_DESCR_PRIM(struct iBeacon_info, minor, JSON_TOK_NUMBER),
    JSON_OBJ_DESCR_PRIM(struct iBeacon_info, x, JSON_TOK_NUMBER),
    JSON_OBJ_DESCR_PRIM(struct iBeacon_info, y, JSON_TOK_NUMBER),
    JSON_OBJ_DESCR_PRIM(struct iBeacon_info, left_name, JSON_TOK_STRING),
    JSON_OBJ_DESCR_PRIM(struct iBeacon_info, right_name, JSON_TOK_STRING),
};

/* ========================================================================== */
/* Initial settings                                                           */
/* ========================================================================== */

static const int16_t xs_init[MAX_BEACON_COUNT] = {
    170, 0, -150, -150, -150, -150, -150, 0, 170, 170, 170, 170, 0};

static const int16_t ys_init[MAX_BEACON_COUNT] = {
    -450, -450, -450, -200, 0, 225, 400, 400, 400, 200, 0, -250, 0};

static const uint16_t majors_init[MAX_BEACON_COUNT] = {
    2753,  32975, 26679, 41747, 30679, 6195, 30525,
    57395, 60345, 12249, 36748, 27564, 49247};

static const uint16_t minors_init[MAX_BEACON_COUNT] = {
    32998, 20959, 40363, 38800, 51963, 18394, 30544,
    28931, 49995, 30916, 11457, 27589, 52925};

static const char name_init[NAME_INITIAL_BUFFER_LEN] = "4011-A";

static const char addresses_init[MAX_BEACON_COUNT][ADDRESS_BUFFER_LEN] = {
    "F5:75:FE:85:34:67", "E5:73:87:06:1E:86", "CA:99:9E:FD:98:B1",
    "CB:1B:89:82:FF:FE", "D4:D2:A0:A4:5C:AC", "C1:13:27:E9:B7:7C",
    "F1:04:48:06:39:A0", "CA:0C:E0:DB:CE:60", "D4:7F:D4:7C:20:13",
    "F7:0B:21:F1:C8:E1", "FD:E0:8D:FA:3E:4A", "EE:32:F7:28:FA:AC",
    "F7:3B:46:A8:D7:2C"};

/* ========================================================================== */
/* State definitions                                                          */
/* ========================================================================== */

extern struct k_mutex beacons_mutex;
extern sys_slist_t slist_iBeacon;

/* ========================================================================== */
/* Function definitions                                                       */
/* ========================================================================== */

int initialise_beacons();

int add_beacon(char name);
int add_arbitrary_beacon(struct iBeacon_info *info_args);
int remove_beacon(char name);
int remove_arbitrary_beacon(char *address);
int list_beacons();

#endif
```

## src/kalman.c
```c
/* ========================================================================== */
/* Kalman Filter Algorithm Source                                             */
/* Written: Muhammed A                                                        */
/* ========================================================================== */

#include "kalman.h"

#include <stdlib.h>
#include <math.h>
#include <zephyr/kernel.h>

#define KALMAN_DT 0.1f

// A lot of these seem really as if they came out of nowhere, but they're the
// process of trying to simplify the arithmetic of matrix multiplications
// as significantly as possible. For example, calculating the P array in 
// kf_predict requires calculating F * P * F^T - but since F is a constant
// (and a simple one at that), it is very significantly faster, safer, and 
// much more memory efficient to just simplify it. These simplifications were
// done using https://www.matrixmultiplicationscalculator.com/ because I don't
// trust my matrix multiplication skills lol

static const double kalman_dt = KALMAN_DT;
static const double kalman_dt2 = pow(KALMAN_DT, 2);

void kf_init(struct kalman *kf, double Q, double R, double x0)
{
    kf->Q = Q;
    kf->R = R;

    // Starting at 0 (this is only for one axis)
    kf->x_k[0] = x0;
    kf->x_k[1] = 0;

    // We just want a simple P matrix at the beginning since we have no 
    // information about our sensor variance
    kf->P[0][0] = 1;
    kf->P[1][1] = 1;
    kf->P[0][1] = 0;
    kf->P[1][0] = 0;
}

// Predict first...
void kf_predict(struct kalman *kf)
{
    // Constant velocity - just adds the velocity from last time on.
    kf->x_k[0] += kalman_dt * kf->x_k[1];

    kf->P[0][0] += kf->P[0][1] + kalman_dt * kf->P[1][0] +
                   kalman_dt2 * kf->P[1][1] + kf->Q;
    kf->P[0][1] += kalman_dt * kf->P[1][1];
    kf->P[1][0] += kalman_dt * kf->P[1][1];
    kf->P[1][1] += kf->Q;
}

// Get the values...
// Then update:
void kf_update(struct kalman *kf, double measurement)
{
    double K[2];
    // By the miracle of matrix multiplication, the calculation for HPH^T
    // literally just flattens to being the first item of the P array.
    double K_scaling = 1 / (kf->P[0][0] + kf->R);
    K[0] = K_scaling * kf->P[0][0];
    K[1] = K_scaling * kf->P[1][0];

    // Calculating x_update
    kf->x_k[0] += K[0] * (measurement - kf->x_k[0]);
    kf->x_k[1] += K[1] * (measurement - kf->x_k[0]);

    // When calculating (I - K*H), it is of the form [1-K[0]  0], [-K[1]  1]
    // Hence there are only two variables - here they are known as A and B,
    // where A = 1 - K[0]; and B = -K[1];
    double a = 1 - K[0];
    double b = -K[1];

    kf->P[1][0] += kf->P[0][0] * b;
    kf->P[1][1] += kf->P[0][1] * b;

    kf->P[0][0] *= a;
    kf->P[0][1] *= a;
}
```

## src/kalman.h
```c
/* ========================================================================== */
/* Kalman Filter Algorithm Header                                             */
/* Written: Muhammed A                                                        */
/* ========================================================================== */

#ifndef BASE_KALMAN_H
#define BASE_KALMAN_H

#include <zephyr/kernel.h>

// Default values (this was just trial and error)
#define KF_Q  0.5
#define KF_R  20
#define KF_X0 0

struct kalman {
    // F will always be [1 dt] [0 1]
    // H matrix is [1 0] 
    double Q;
    double R;

    double x_k[2];
    double P[2][2];
};

void kf_init(struct kalman *kf, double Q, double R, double x0);
void kf_predict(struct kalman *kf);
void kf_update(struct kalman *kf, double measurement);

#endif
```

## src/location.c
```c
/* ========================================================================== */
/* Multilateration Calculator Source                                          */
/* Written: Muhammed A                                                        */
/* ========================================================================== */

// Foreword:
// Since our testing found that the device actually performs *significantly*
// worse when all 13 beacons are used for multilateration, we decided to skip
// that and just use the 4 best functioning beacons. The reason we went with
// 4 rather than 3 is because 3 beacons can cause zero-determinant situations
// if the 3 closest beacons are in a straight line. Therefore we actually
// wouldn't be able to tell on which side of the line we're on. This is much
// less of a problem with 4 beacons.
//
// Essentially, the more beacons you have, the harder it is for the system to
// not know which side you're on - but at the same time, due to the ridiculous
// amount of noise coming from the RSSI readings, the effect is just too much
// to handle (even with heavy Kalmanning)

#include "beacons.h"
#include "kalman.h"
#include "location.h"
#include "nus.h"
#include "sniffer.h"

#include <math.h>

#include <zephyr/data/json.h>
#include <zephyr/kernel.h>

/* ========================================================================== */
/* Memory management                                                          */
/* ========================================================================== */

// Max room dimensions
#define X_MAX 170
#define Y_MAX 450

#define THREAD_PRIORITY 5
#define THREAD_STACK    4096
#define HEAP_SIZE       4096

// We use a heap here since 4096 is not that much space when everything is
// 4-bit ints/doubles!
K_HEAP_DEFINE(location_heap, HEAP_SIZE);

/* ========================================================================== */
/* Current state                                                              */
/* ========================================================================== */

// Only accessed when distance_mutex is set.
static double pseudoinverse[2][MULTILATERATION_BEACONS - 1];

// These only get accessed from the one thread, so it doesn't need a mutex.
static struct lateration current_position;
static struct lateration current_position_kf;
static struct kalman kf_x;
static struct kalman kf_y;

/* ========================================================================== */
/* Constants                                                                  */
/* ========================================================================== */

#define JSON_BUFFER_SIZE_LOC 128
#define NODE_DELIMITER       "|"
#define VAL_DELIMITER        ","

/* ========================================================================== */
/* A-matrix calculators                                                       */
/* ========================================================================== */

// Why doesn't C have exponents?!
#define SQUARE(x) ((x) * (x))

// Calculate the pseudoinverse for the 4 closest beacons
static void recalculate_pseudoinverse(struct iBeacon_data **beacons)
{
    // Initialise some memory for the A matrix - this will be freed after
    int row_count = MULTILATERATION_BEACONS - 1;
    int16_t a_matrix[row_count][2];

    double a = 0, bc = 0, d = 0;

    for (int i = 0; i < row_count; i++) {
        a_matrix[i][0] = 2 * (beacons[0]->info->x - beacons[i + 1]->info->x);
        a_matrix[i][1] = 2 * (beacons[0]->info->y - beacons[i + 1]->info->y);

        // Simplified version - A^T * A actually comes out to:
        // A being the sum of all of the x-differences^2
        // D being the sum of all of the y-differences^2
        // B = C being the sum of all of the x*y differences
        a += SQUARE(a_matrix[i][0]);
        d += SQUARE(a_matrix[i][1]);
        bc += a_matrix[i][0] * a_matrix[i][1];
    }

    double determinant = (a * d) - SQUARE(bc);
    if (determinant == 0) {
        // Just don't bother...
        return;
    }

    // Get the inverse - so, (A^T A)^-1
    double temp = a;
    a = d / determinant;
    d = temp / determinant;
    bc = -bc / determinant;

    // Multiply by A^T*W one last time...
    for (int i = 0; i < row_count; i++) {
        pseudoinverse[0][i] = (a * a_matrix[i][0] + bc * a_matrix[i][1]);
        pseudoinverse[1][i] = (bc * a_matrix[i][0] + d * a_matrix[i][1]);
    }
}

// qsort helper to compare by distance of beacons
int distance_compare(const void *a, const void *b)
{
    const struct iBeacon_data *beaconA = *(const struct iBeacon_data **)a;
    const struct iBeacon_data *beaconB = *(const struct iBeacon_data **)b;

    return beaconA->distance - beaconB->distance;
}

// Sort the beacons by distance and return the array of pointers (not actual
// structs !!) on the heap. This needs to be freed!
static struct iBeacon_data **get_sorted_beacons(int count)
{
    struct iBeacon_data **beacons = k_heap_calloc(
        &location_heap, count, sizeof(struct iBeacon_data *), K_NO_WAIT);

    if (!beacons) {
        printk("L: Failed to make space for beacons array\n");
        return NULL;
    }

    struct iBeacon_data *list_node =
        SYS_SLIST_PEEK_HEAD_CONTAINER(&slist_iBeacon, list_node, node);

    for (int i = 0; i < count && list_node != NULL; i++) {
        beacons[i] = list_node;
        list_node = SYS_SLIST_PEEK_NEXT_CONTAINER(list_node, node);
    }

    qsort(beacons, count, sizeof(struct iBeacon_data *), distance_compare);
    return beacons;
}

/* ========================================================================== */
/* Location calculator from b-matrix                                          */
/* ========================================================================== */

// Calculate location using x = (AtA)^-1AtB - this function just multiplies the
// stuff out the front with B.
static int calculate_location(double *x_meas, double *y_meas)
{
    // Don't change distances while this is running
    if (k_mutex_lock(&beacons_mutex, K_MSEC(LOCATION_UPDATE_RATE_MS)) != 0) {
        printk("L: Mutex not unlocking!\n");
        return -1;
    }

    struct iBeacon_data **beacons =
        get_sorted_beacons(sys_slist_len(&slist_iBeacon));

    if (!beacons) {
        return -1;
    }

    recalculate_pseudoinverse(beacons);

    // Below is just the matrix calculations to find the B vector,
    int row_count = MULTILATERATION_BEACONS - 1;
    int32_t b_vec[row_count];
    int32_t k_term = SQUARE(beacons[0]->info->x) + SQUARE(beacons[0]->info->y) -
                     SQUARE(beacons[0]->distance);

    for (int i = 0; i < row_count; i++) {
        b_vec[i] = k_term - SQUARE(beacons[i + 1]->info->y) -
                   SQUARE(beacons[i + 1]->info->x) +
                   SQUARE(beacons[i + 1]->distance);
    }

    double x = 0, y = 0;

    // And then multiply by the stuff out the front
    for (int i = 0; i < row_count; i++) {
        x += b_vec[i] * pseudoinverse[0][i];
        y += b_vec[i] * pseudoinverse[1][i];
    }

    // Below just caps the location to the maximum (otherwise we get very
    // silly values)
    int sign = (y > 0) ? 1 : -1;

    if (abs(x) > X_MAX) {
        sign = (x > 0) ? 1 : -1;
        x = sign * X_MAX;
    }

    if (abs(y) > Y_MAX) {
        sign = (y > 0) ? 1 : -1;
        y = sign * Y_MAX;
    }

    *x_meas = x;
    *y_meas = y;
    k_heap_free(&location_heap, beacons);

    k_mutex_unlock(&beacons_mutex);

    return 0;
}

/* ========================================================================== */
/* Parser for received beacon data                                            */
/* ========================================================================== */

#define MAJOR_IDX 0
#define MINOR_IDX 1
#define RSSI_IDX  2

// Go through the linked list and update its distance using the formula
// desribed in class
static void check_list_and_update(int32_t major, int32_t minor, int32_t rssi)
{
    int cur_beacon = sys_slist_len(&slist_iBeacon);

    struct iBeacon_data *list_node =
        SYS_SLIST_PEEK_HEAD_CONTAINER(&slist_iBeacon, list_node, node);

    for (int i = 0; i < cur_beacon && list_node != NULL; i++) {
        if (list_node->info->major == major &&
            list_node->info->minor == minor) {
            double distance = (BEACONS_RSSI_A - rssi) / (10.0 * BEACONS_RSSI_N);

            // Get the distance in cm, rather than metres.
            distance = pow(10.0, distance) * 100;
            list_node->distance = distance;
            return;
        }
        list_node = SYS_SLIST_PEEK_NEXT_CONTAINER(list_node, node);
    }
}

// Given the below (major,minor,rssi) packet, split it up on the commas, and
// then try to parse that and add it to the given nod.
static void parse_beacon_data(char *beacon_data)
{
    char *val_saveptr;
    char *endptr;
    char *val = strtok_r(beacon_data, VAL_DELIMITER, &val_saveptr);

    int32_t values[3] = {0, 0, 0};
    uint8_t value_count = 0;

    while (val != NULL && value_count < 3) {
        values[value_count++] = strtol(val, &endptr, 10);

        if (endptr == val) {
            return;
        }

        // Kind of ugly but it works.
        val = strtok_r(NULL, VAL_DELIMITER, &val_saveptr);
    }

    if (val) {
        return;
    }

    check_list_and_update(values[MAJOR_IDX], values[MINOR_IDX],
                          values[RSSI_IDX]);
}

// The data is of the form {major,minor,rssi}|... - this function just gets
// the individual three value packets, and sends them off to parse_beacon_data
// to be further split up on the commas.
static void parse_nus_data(char *data)
{
    char *beacon_saveptr;
    char *beacon_meas = strtok_r(data, NODE_DELIMITER, &beacon_saveptr);

    // Make sure that the beacons can't be removed/altered during this process
    if (k_mutex_lock(&beacons_mutex, K_MSEC(LOCATION_UPDATE_RATE_MS)) != 0) {
        printk("L: Mutex not unlocking!\n");
        return;
    }

    while (beacon_meas != NULL) {
        parse_beacon_data(beacon_meas);
        beacon_meas = strtok_r(NULL, NODE_DELIMITER, &beacon_saveptr);
    }

    k_mutex_unlock(&beacons_mutex);
}

/* ========================================================================== */
/* Threads to receive data and calculate distance                             */
/* ========================================================================== */

// Get packets from the mobile node, try to parse them. This is a lifelong
// thread.
static void nus_collector(void *, void *, void *)
{
    while (1) {
        struct nus_package *package = k_fifo_get(&nus_package_fifo, K_FOREVER);

        if (package != NULL) {
            parse_nus_data(package->data);
            k_heap_free(&nus_package_heap, package->data);
            k_heap_free(&nus_package_heap, package);
        }

        k_msleep(5);
    }
}

// Calculate the location on a loop...
static void calculate_location_loop(void *, void *, void *)
{
    // Kalmans for both x and y
    kf_init(&kf_x, KF_Q, KF_R, KF_X0);
    kf_init(&kf_y, KF_Q, KF_R, KF_X0);

    char *json_buffer =
        k_heap_alloc(&location_heap, JSON_BUFFER_SIZE_LOC, K_NO_WAIT);

    // Make sure we aren't running out of memory!
    if (!json_buffer) {
        printk("L: OOPS! Not enough space for the json buffer.\n");
        return;
    }

    double x = 0, y = 0;

    while (1) {
        // predict the new locations...
        kf_predict(&kf_x);
        kf_predict(&kf_y);

        calculate_location(&x, &y);

        // Then set the current and kalmaned positions. We do velocity/distance
        // calculations on the computer since it wasn't specified to be done
        // here.
        current_position.x = x;
        current_position.y = y;

        current_position_kf.x = kf_x.x_k[0];
        current_position_kf.y = kf_y.x_k[0];

        // If the sniffer is active, we don't print out distance data. This
        // loop still keeps going though - there's no real reason to stop it
        // since it's still receiving data from NUS (This helps the kalman stay
        // accurate too).
        if (!atomic_get(&sniffer_active)) {
            json_buffer[0] = '\0';

            if (json_obj_encode_buf(lateration_descr,
                                    ARRAY_SIZE(lateration_descr),
                                    &current_position, json_buffer,
                                    JSON_BUFFER_SIZE_LOC) == 0) {
                // P prefix for non-kalman position
                printk("P: %s\n", json_buffer);
            }

            json_buffer[0] = '\0';

            if (json_obj_encode_buf(lateration_descr,
                                    ARRAY_SIZE(lateration_descr),
                                    &current_position_kf, json_buffer,
                                    JSON_BUFFER_SIZE_LOC) == 0) {
                // K prefix for kalman position
                printk("K: %s\n", json_buffer);
            }
        }

        // Finally, update your location in the Kalman filter!
        kf_update(&kf_x, x);
        kf_update(&kf_y, y);

        k_msleep(LOCATION_UPDATE_RATE_MS);
    }

    k_heap_free(&location_heap, json_buffer);
}

/* ========================================================================== */
/* Thread definitions                                                         */
/* ========================================================================== */

K_THREAD_STACK_DEFINE(calculate_location_stack, THREAD_STACK);
K_THREAD_STACK_DEFINE(nus_collector_stack, THREAD_STACK);

struct k_thread calculate_location_thread;
struct k_thread nus_collector_thread;

/* ========================================================================== */
/* Multilateration memory & task initialisers                                 */
/* ========================================================================== */

int initialise_multilateration(void)
{
    int ret = initialise_beacons();

    if (!ret) {
        // success...
        k_thread_create(&calculate_location_thread, calculate_location_stack,
                        K_THREAD_STACK_SIZEOF(calculate_location_stack),
                        calculate_location_loop, NULL, NULL, NULL,
                        THREAD_PRIORITY, 0, K_NO_WAIT);
        k_thread_create(&nus_collector_thread, nus_collector_stack,
                        K_THREAD_STACK_SIZEOF(nus_collector_stack),
                        nus_collector, NULL, NULL, NULL, THREAD_PRIORITY, 0,
                        K_NO_WAIT);
        return 0;
    }

    return -1;
}
```

## src/location.h
```c
/* ============================================================== */
/* Multilateration calculator Header                              */
/* Written: Muhammed A                                            */
/* ============================================================== */

#ifndef BASE_LOCATION_H
#define BASE_LOCATION_H

#include "beacons.h"
#include "nus.h"

#include <stdlib.h>
#include <zephyr/data/json.h>
#include <zephyr/kernel.h>

#define LOCATION_UPDATE_RATE_MS 100

/* ========================================================================== */
/* Current Location                                                           */
/* ========================================================================== */

struct lateration {
    // Stored as two variables for JSON - in cm.
    int x;
    int y;
};

static const struct json_obj_descr lateration_descr[] = {
    JSON_OBJ_DESCR_PRIM(struct lateration, x, JSON_TOK_NUMBER),
    JSON_OBJ_DESCR_PRIM(struct lateration, y, JSON_TOK_NUMBER)};

/* ========================================================================== */
/* Function calls                                                             */
/* ========================================================================== */

int initialise_multilateration();

#endif
```

## src/nus.h
```c
/* ============================================================== */
/* NUS connection header                                          */
/* Written: Muhammed A                                            */
/* ============================================================== */

#ifndef BASE_NUS_H
#define BASE_NUS_H

#include <zephyr/kernel.h>

#define ADDRESS_BUFFER_LEN 18
#define NUS_MAX_MTU        247


// Making space for our data fifo - since the data pointer is so huge it has
// to be made on the heap - same with the struct itself (since it gets
// given to the FIFO and there is no guarantee the callingfunction will still 
// have its stack intact!)
struct nus_package {
    void *fifo_reserved;
    char *data;
};

extern struct k_heap nus_package_heap;
extern struct k_fifo nus_package_fifo;

int start_scan();

#endif
```

## src/sniffer.c
```c
/* ============================================================== */
/* Sniffer Mode Source                                            */
/* Written: Muhammed A                                            */
/* ============================================================== */

#include "sniffer.h"

#include <stdio.h>
#include <strings.h>

#include <zephyr/bluetooth/bluetooth.h>
#include <zephyr/data/json.h>
#include <zephyr/kernel.h>

#define HEAP_SIZE          1024
#define IBEACON_ID_LEN     4
#define JSON_BUFFER_SIZE   128
#define MAX_NAME_LENGTH    30
#define ADDRESS_BUFFER_LEN 18

/* ========================================================================== */
/* Constant Decs                                                              */
/* ========================================================================== */

// Define a heap to store our JSON in - we don't want to put big buffers on our
// stack
K_HEAP_DEFINE(json_buffer_heap, HEAP_SIZE);

struct iBeacon_package {
    char *address;
    int major;
    int minor;
    int rssi;
    bool is_iBeacon;
};

static const struct json_obj_descr iBeacon_package_descr[] = {
    JSON_OBJ_DESCR_PRIM(struct iBeacon_package, address, JSON_TOK_STRING),
    JSON_OBJ_DESCR_PRIM(struct iBeacon_package, major, JSON_TOK_NUMBER),
    JSON_OBJ_DESCR_PRIM(struct iBeacon_package, minor, JSON_TOK_NUMBER),
    JSON_OBJ_DESCR_PRIM(struct iBeacon_package, rssi, JSON_TOK_NUMBER)};

// Filtering iBeacons..
static const char iBeaconId[IBEACON_ID_LEN] = {0x4c, 0x00, 0x02, 0x15};

atomic_t sniffer_active = ATOMIC_INIT(false);

/* ========================================================================== */
/* Beacon Detection                                                           */
/* ========================================================================== */

// set the user_data iBeacon found to true if it is one, otherwise just ignore.
static bool mfg_data_cb(struct bt_data *data, void *user_data)
{
    struct iBeacon_package *pkg = user_data;

    switch (data->type) {
    case BT_DATA_MANUFACTURER_DATA:
        uint16_t len = data->data_len;
        if (len > 5) {
            for (int i = 0; i < IBEACON_ID_LEN; i++) {
                if (iBeaconId[i] != data->data[i]) {
                    return false;
                }
            }

            pkg->is_iBeacon = true;
            pkg->major = (data->data[len - 5] << 8) | (data->data[len - 4]);
            pkg->minor = (data->data[len - 3] << 8) | (data->data[len - 2]);
        }
        return false;
    default:
        return true;
    }
}

// This is called from nus.c - it returns true if addr was run through
// bt_data_parse (i.e. if its data was destroyed) and false otherwise - this
// includes if the item was not actually an iBeacon.
bool sniffer_write(const bt_addr_le_t *addr, int8_t rssi, uint8_t type,
                   struct net_buf_simple *ad)
{
    if (ad->len >= 1 && atomic_get(&sniffer_active)) {
        struct iBeacon_package pkg = {.is_iBeacon = false, .rssi = rssi};
        bt_data_parse(ad, mfg_data_cb, &pkg);

        if (pkg.is_iBeacon) {
            char addr_str[BT_ADDR_LE_STR_LEN];
            bt_addr_le_to_str(addr, addr_str, BT_ADDR_LE_STR_LEN);
            addr_str[ADDRESS_BUFFER_LEN - 1] = 0;

            pkg.address = addr_str;

            char *json_buffer =
                k_heap_alloc(&json_buffer_heap, JSON_BUFFER_SIZE, K_NO_WAIT);

            // Make sure to check so we don't run into a segfault!
            if (json_buffer == NULL) {
                printk("L: Run out of JSON memory!\n");
                return true;
            }

            // And then just encode the iBeacon as a JSON string.
            if (json_obj_encode_buf(iBeacon_package_descr,
                                    ARRAY_SIZE(iBeacon_package_descr), &pkg,
                                    json_buffer, JSON_BUFFER_SIZE) == 0) {
                printk("S: %s\n", json_buffer);
                k_msleep(1);
            }

            k_heap_free(&json_buffer_heap, json_buffer);
        }

        return true;
    }

    return false;
}
```

## src/sniffer.h
```c
/* ============================================================== */
/* Sniffer Mode Header                                            */
/* Written: Muhammed A                                            */
/* ============================================================== */

#ifndef BASE_SNIFFER_H
#define BASE_SNIFFER_H

#include <stdlib.h>

#include <zephyr/bluetooth/bluetooth.h>
#include <zephyr/kernel.h>

extern atomic_t sniffer_active;

bool sniffer_write(const bt_addr_le_t *addr, int8_t rssi, uint8_t type,
                       struct net_buf_simple *ad);

#endif
```
