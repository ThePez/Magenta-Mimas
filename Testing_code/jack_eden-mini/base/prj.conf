## CMakeLists.txt
```
# SPDX-License-Identifier: Apache-2.0

cmake_minimum_required(VERSION 3.20.0)
find_package(Zephyr REQUIRED HINTS $ENV{ZEPHYR_BASE})
project(mini-project-base)

target_sources(app PRIVATE 
    src/main.c
    src/base_gatt.c
    src/localisation.c
    src/rb_tree.c
    src/ble_shell.c
    src/observer.c
    src/uart.c
    src/json.c
    src/matrix.c
    src/kalman.c
)
```

## prj.conf
```kconfig
# Bluetooth stuff
CONFIG_BT=y
CONFIG_BT_CENTRAL=y         # for NUS client
CONFIG_BT_ZEPHYR_NUS=y      # for NUS
CONFIG_BT_GATT_CLIENT=y     # to discover "mobile chip"
CONFIG_BT_OBSERVER=y        # for scanning
CONFIG_BT_EXT_ADV=y         # for scanning
CONFIG_BT_MAX_CONN=1

# More BT stuff
# Data Length Extension and MTU  
CONFIG_BT_USER_DATA_LEN_UPDATE=y
CONFIG_BT_CTLR_DATA_LENGTH_MAX=251
CONFIG_BT_BUF_ACL_RX_SIZE=251
CONFIG_BT_BUF_ACL_TX_SIZE=251
CONFIG_BT_L2CAP_TX_MTU=247

# Enables the use of k_malloc
CONFIG_HEAP_MEM_POOL_SIZE=4096

# Float support for printk
CONFIG_CBPRINTF_FP_SUPPORT=y

# JSON Library
CONFIG_JSON_LIBRARY=y

# Enable the Floating Point Unit in hardware
CONFIG_FPU=y
CONFIG_FPU_SHARING=y # Save FPU registers on context switch

# Possible Stack error detection in hardware
CONFIG_HW_STACK_PROTECTION=y

# UART Stuff
CONFIG_SERIAL=y
CONFIG_UART_INTERRUPT_DRIVEN=y
```

## src/main.c
```c
/*
 * Copyright (c) 2026 Jack Cairns, Eden Mehr
 *
 * SPDX-License-Identifier: Apache-2.0
 */

#include "base_gatt.h"

#include <zephyr/kernel.h>
#include <zephyr/sys/printk.h>
#include <zephyr/bluetooth/bluetooth.h>

// Fatal warning message on startup
static const char *const warn_message =
    "Big RIP. Nothing works now, power cycle the chip to try again";

/* ========================================================================== */
/* ENTRY POINT                                                                */
/* Initialise BT then kick off step 1. Everything else is                     */
/* event driven from the BT stack callbacks.                                  */
/* ========================================================================== */
int main(void)
{
    printk("CSSE4011 Mini-Project Base Chip\r\n");

    int err = bt_enable(NULL);
    if (err) {
        printk("[ERROR] Bluetooth init failed (err %d)\n%s\r\n", err, warn_message);
        return (err);
    }

    printk("[INFO] Bluetooth initialized\r\n");

    err = start_scan(); /* STEP 1 for GATT process */
    if (err) {
        printk("Initial scan failed (err %d)\n%s\n", err, warn_message);
        return (err);
    }

    return (0);
}

/*

1. Mobile to sniff iBeacons - Prac 5 code - repurposed Jack's prac 5 code - DONE

2. Base/Mobile to form GATT connection -> central_hr example plus Sam's example - Jack - DONE

3. Mobile to send packets via NUS -> peripheral_nus - Jack - DONE

4. Need either Red/Black Tree or a LinkedList containing all the 13 iBeacons  - Eden - DONE

5. Shell commands to add, remove, view iBeacons in the storage structure. - Eden - DONE

6. base also needs to be able to do what mobile does, minus the NUS coms stuff.  - Jack - DONE

7. Impliment an algorithm for calculating the approximate position of mobile - Jack - DONE

8. Impliment a Kalman filter to improve the approximate position algorithm. - Eden - DONE

9. Use Zephyr API for Json packet creation and send this data to the PC over UART - Jack - DONE

10. Modify existing GUI to accept these Json packets - Jack - DONE

11. Replace the shell interface with buttons in the GUI. - Jack - DONE

12. Setup webserver dashboard and api - Eden - DONE

13. Modify the GUI to send the data to a webserver. - DONE


DONE :)

*/
```

## src/base_gatt.c
```c
/*
 * Copyright (c) 2026 Jack Cairns, Eden Mehr
 *
 * SPDX-License-Identifier: Apache-2.0
 */

#include "base_gatt.h"
#include "observer.h"

#include <stdint.h>

#include <zephyr/sys/printk.h>
#include <zephyr/bluetooth/bluetooth.h>
#include <zephyr/bluetooth/hci.h>
#include <zephyr/bluetooth/conn.h>
#include <zephyr/bluetooth/uuid.h>
#include <zephyr/bluetooth/services/nus.h>
#include "zephyr/bluetooth/services/nus/inst.h"
#include <zephyr/kernel.h>
#include <zephyr/bluetooth/gatt.h>
#include <zephyr/sys/atomic.h>

/* ========================================================================== */
/* Function Prototypes                                                        */
/* ========================================================================== */

static uint8_t discover_func(struct bt_conn *conn, const struct bt_gatt_attr *attr,
                             struct bt_gatt_discover_params *params);

/* ========================================================================== */
/* Configuration                                                              */
/* ========================================================================== */

/* Mobile chip address - hardcoded for filtering */
static const bt_addr_le_t mobile_addr = {
    .type = BT_ADDR_LE_RANDOM, .a.val = {0x56, 0x63, 0xCD, 0x44, 0x4A, 0xE1}
    // E1:4A:44:CD:63:56
};

/* ========================================================================== */
/* Static Data                                                                */
/* ========================================================================== */

/* Holds the active connection once we connect to the mobile */
static struct bt_conn *mobile_connection;

/* Reused UUID buffer - gets overwritten at each stage of
 * discovery to tell bt_gatt_discover() what to look for next.
 * 128-bit to accommodate NUS UUIDs */
static struct bt_uuid_128 discover_uuid = BT_UUID_INIT_128(0);

/* Params passed to bt_gatt_discover() - must stay valid for
 * entire async discovery process, hence static */
static struct bt_gatt_discover_params discover_params;

/* Params passed to bt_gatt_subscribe() - must stay valid for
 * the entire time we are subscribed, hence static */
static struct bt_gatt_subscribe_params subscribe_params;

/* Atomic flag for closing ble connection intentionally */
static atomic_t intentional_disconnect = ATOMIC_INIT(0);

K_MSGQ_DEFINE(ibeacon_msg_queue, sizeof(struct iBeacon), 60, 4);

/* ========================================================================== */
/* NUS NOTIFICATION CALLBACK                                                  */
/* Fires every time the mobile sends a NUS notification.                      */
/* data == NULL indicates unsubscription (e.g. mobile disconnected).          */
/* Forwards received iBeacon structs to ibeacon_msg_queue.                   */
/* ========================================================================== */
static uint8_t notify_func(struct bt_conn *conn, struct bt_gatt_subscribe_params *params,
                           const void *data, uint16_t length)
{
    /* data == NULL means we got unsubscribed (e.g. mobile disconnected) */
    if (!data) {
        printk("[WARN] Unsubscribed\n");
        params->value_handle = 0U;
        return (BT_GATT_ITER_STOP);
    }

    struct iBeacon *beacon = (struct iBeacon *)data;
    /* Send the iBeacon Data to the message queue */
    k_msgq_put(&ibeacon_msg_queue, beacon, K_NO_WAIT);
    return (BT_GATT_ITER_CONTINUE); /* keep receiving notifications */
}

/* ========================================================================== */
/* STEP 3: DISCOVER NUS SERVICE                                               */
/* Kicks off the discovery chain from the connected() callback.               */
/* Searches the full GATT database for the NUS primary service.               */
/* ========================================================================== */
void set_discover_nus_service(void)
{
    memcpy(&discover_uuid, BT_UUID_NUS_SERVICE, sizeof(discover_uuid));
    discover_params.uuid = &discover_uuid.uuid;
    discover_params.func = discover_func;
    discover_params.start_handle = BT_ATT_FIRST_ATTRIBUTE_HANDLE;
    discover_params.end_handle = BT_ATT_LAST_ATTRIBUTE_HANDLE;
    discover_params.type = BT_GATT_DISCOVER_PRIMARY;

    int err = bt_gatt_discover(mobile_connection, &discover_params);
    if (err) {
        printk("[ERROR] Discover failed(err %d)\n", err);
    }
}

/* ========================================================================== */
/* STEP 4: DISCOVER NUS TX CHARACTERISTIC                                     */
/* Called once the NUS service is found.                                      */
/* Searches within the service for the TX characteristic.                     */
/* ========================================================================== */
void set_discover_nus_tx(struct bt_conn *conn, const struct bt_gatt_attr *attr)
{
    memcpy(&discover_uuid, BT_UUID_NUS_TX_CHAR, sizeof(discover_uuid));
    discover_params.uuid = &discover_uuid.uuid;
    discover_params.start_handle = attr->handle + 1; /* search after service handle */
    discover_params.type = BT_GATT_DISCOVER_CHARACTERISTIC;

    int err = bt_gatt_discover(conn, &discover_params);
    if (err) {
        printk("[ERROR] Discover failed (err %d)\n", err);
    }
}

/* ========================================================================== */
/* STEP 5: DISCOVER CCCD DESCRIPTOR                                           */
/* Called once the TX characteristic is found.                                */
/* Saves the value handle, then finds the CCCD descriptor.                    */
/* attr->handle = declaration handle                                          */
/* value_handle = actual data handle used for subscription                    */
/* ========================================================================== */
void set_discover_uuid_gatt_ccc(struct bt_conn *conn, const struct bt_gatt_attr *attr)
{
    memcpy(&discover_uuid, BT_UUID_GATT_CCC, sizeof(struct bt_uuid_16)); /* 16-bit source */
    discover_params.uuid = &discover_uuid.uuid;
    discover_params.start_handle = attr->handle + 2; /* CCCD sits 2 handles after chrc */
    discover_params.type = BT_GATT_DISCOVER_DESCRIPTOR;

    /* Save value handle now - needed later when subscribing */
    subscribe_params.value_handle = bt_gatt_attr_value_handle(attr);

    int err = bt_gatt_discover(conn, &discover_params);
    if (err) {
        printk("[ERROR] Discover failed (err %d)\n", err);
    }
}

/* ========================================================================== */
/* STEP 6: SUBSCRIBE TO TX NOTIFICATIONS                                      */
/* Called once the CCCD is found.                                             */
/* Writes 0x0001 to the CCCD, telling the mobile to start                     */
/* sending notifications. notify_func fires on each packet.                   */
/* ========================================================================== */
void set_discover_nus_sub(struct bt_conn *conn, const struct bt_gatt_attr *attr)
{
    subscribe_params.notify = notify_func;
    subscribe_params.value = BT_GATT_CCC_NOTIFY; /* 0x0001 - enable notifications */
    subscribe_params.ccc_handle = attr->handle;  /* the CCCD handle */

    int err = bt_gatt_subscribe(conn, &subscribe_params);
    if (err && err != -EALREADY) {
        printk("[ERROR] Subscribe failed (err %d)\n", err);
    } else {
        printk("[INFO] NUS Subscribed\n");
    }
}

/* ========================================================================== */
/* DISCOVERY CHAIN CALLBACK                                                   */
/* Single callback reused for all discovery stages.                           */
/* Identifies current stage by comparing discover_params.uuid                 */
/* against what was being searched, then kicks off next stage.                */
/* ========================================================================== */
static uint8_t discover_func(struct bt_conn *conn, const struct bt_gatt_attr *attr,
                             struct bt_gatt_discover_params *params)
{
    /* attr == NULL means this stage found nothing */
    if (!attr) {
        printk("Discover complete\n");
        (void)memset(params, 0, sizeof(*params));
        return (BT_GATT_ITER_STOP);
    }

    printk("[INFO] handle: %u\n", attr->handle);

    if (!bt_uuid_cmp(discover_params.uuid, BT_UUID_NUS_SERVICE)) {
        set_discover_nus_tx(conn, attr); /* STEP 3 -> STEP 4 */
    } else if (!bt_uuid_cmp(discover_params.uuid, BT_UUID_NUS_TX_CHAR)) {
        set_discover_uuid_gatt_ccc(conn, attr); /* STEP 4 -> STEP 5 */
    } else {
        set_discover_nus_sub(conn, attr); /* STEP 5 -> STEP 6 */
        return (BT_GATT_ITER_STOP);
    }

    return (BT_GATT_ITER_STOP);
}

/* ========================================================================== */
/* STEP 2: DEVICE FOUND DURING SCAN                                           */
/* Fires for every advertising packet seen during scanning.                   */
/* Filters by address then attempts connection to mobile chip.                */
/* ========================================================================== */
static void device_found(const bt_addr_le_t *addr, int8_t rssi, uint8_t type,
                         struct net_buf_simple *ad)
{
    /* Not mobile chip, ignore */
    if (bt_addr_le_cmp(addr, &mobile_addr) != 0) {
        return;
    }

    /* Not connectable, ignore */
    if (type != BT_GAP_ADV_TYPE_ADV_IND && type != BT_GAP_ADV_TYPE_ADV_DIRECT_IND &&
        type != BT_GAP_ADV_TYPE_EXT_ADV) {
        return;
    }

    char dev[BT_ADDR_LE_STR_LEN];
    bt_addr_le_to_str(addr, dev, sizeof(dev));
    printk("[INFO] device: %s, AD evt type %u, AD data len %u, RSSI %i\n", dev, type, ad->len,
           rssi);

    /* Stop scanning before making a connection */
    if (bt_le_scan_stop()) {
        return;
    }

    /* Try Coded PHY first (longer range), fall back to standard 1M PHY */
    struct bt_le_conn_param *param = BT_LE_CONN_PARAM_DEFAULT;
    struct bt_conn_le_create_param *create_param = BT_CONN_LE_CREATE_CONN;

    create_param->options |= BT_CONN_LE_OPT_CODED;
    int err = bt_conn_le_create(addr, create_param, param, &mobile_connection);
    if (err) {
        printk("[WARN] Coded PHY connection failed (err %d), trying 1M PHY\n", err);
        create_param->options &= ~BT_CONN_LE_OPT_CODED;
        err = bt_conn_le_create(addr, create_param, param, &mobile_connection);
        if (err) {
            printk("[ERROR] Create connection failed (err %d)\n", err);
            if (start_scan() < 0) {
                printk("[ERROR] Failed to resume scanning\n");
            }
        }
    }
}

/* ========================================================================== */
/* STEP 1: START SCANNING                                                     */
/* Also called again after disconnection to resume scanning.                  */
/* ========================================================================== */
int start_scan(void)
{
    int err;

    struct bt_le_scan_param scan_param = {
        .type = BT_LE_SCAN_TYPE_ACTIVE,
        .options = BT_LE_SCAN_OPT_CODED,
        .interval = BT_GAP_SCAN_FAST_INTERVAL,
        .window = BT_GAP_SCAN_FAST_WINDOW,
    };

    /* Try with Coded PHY first, fall back to standard 1M PHY */
    err = bt_le_scan_start(&scan_param, device_found);
    if (err) {
        printk("[WARN] Scanning with Coded PHY support failed (err %d)\n", err);
        scan_param.options &= ~BT_LE_SCAN_OPT_CODED;
        err = bt_le_scan_start(&scan_param, device_found);
        if (err) {
            printk("[ERROR] Scanning failed to start (err %d)\n", err);
            return (err);
        }
    }

    printk("[INFO] Looking for GATT connection\n");
    return (0);
}

/* ========================================================================== */
/* Data Length Extension and MTU Exchange                                     */
/*                                                                            */
/* These are two separate negotiations:                                       */
/*   1. DLE  -- over-the-air packet size (bt_conn_le_data_len_update)         */
/*   2. MTU  -- GATT payload size        (bt_gatt_exchange_mtu)               */
/* Both must be requested; each result is min(ours, theirs).                  */
/* ========================================================================== */

static void update_data_length(struct bt_conn *conn)
{
    int err;
    struct bt_conn_le_data_len_param dl_param = {
        .tx_max_len = BT_GAP_DATA_LEN_MAX,
        .tx_max_time = BT_GAP_DATA_TIME_MAX,
    };

    err = bt_conn_le_data_len_update(conn, &dl_param);
    if (err) {
        printk("[ERROR] Data length update failed (err %d)", err);
    }
}

static void on_le_data_len_updated(struct bt_conn *conn, struct bt_conn_le_data_len_info *info)
{
    printk("Data length updated: TX %u bytes (%u us), RX %u bytes (%u us)", info->tx_max_len,
           info->tx_max_time, info->rx_max_len, info->rx_max_time);
}

static void mtu_exchange_cb(struct bt_conn *conn, uint8_t err,
                            struct bt_gatt_exchange_params *params)
{
    if (err) {
        printk("[ERROR] MTU exchange failed (err %u)", err);
    } else {
        uint16_t payload_mtu = bt_gatt_get_mtu(conn) - 3;
        printk("MTU exchange successful: ATT MTU %u, payload %u bytes", bt_gatt_get_mtu(conn),
               payload_mtu);
    }
}

static struct bt_gatt_exchange_params mtu_exchange_params = {
    .func = mtu_exchange_cb,
};

/* ========================================================================== */
/* EVENT: CONNECTED                                                           */
/* Fired by the BT stack when a connection is established.                    */
/* Kicks off the GATT discovery chain.                                        */
/* ========================================================================== */
static void connected(struct bt_conn *conn, uint8_t conn_err)
{
    char addr[BT_ADDR_LE_STR_LEN];
    bt_addr_le_to_str(bt_conn_get_dst(conn), addr, sizeof(addr));

    if (conn_err) {
        printk("[ERROR] Failed to connect to %s (%u)\n", addr, conn_err);
        bt_conn_unref(mobile_connection);
        mobile_connection = NULL;
        if (start_scan() < 0) {
            printk("[ERROR] Failed to resume scanning\n");
        }
        return;
    }

    printk("[INFO] Connected: %s\n", addr);

    /* Request data length extension (over-the-air packet size) */
    update_data_length(conn);

    /* Request MTU exchange (GATT payload size) */
    int err = bt_gatt_exchange_mtu(conn, &mtu_exchange_params);
    if (err) {
        printk("[ERROR] MTU exchange request failed (err %d)", err);
    }

    if (conn == mobile_connection) {
        set_discover_nus_service(); /* kick off STEP 3 */
    }
}

/* ========================================================================== */
/* EVENT: DISCONNECTED                                                        */
/* Fired when connection drops for any reason.                                */
/* Cleans up and restarts scanning to reconnect.                              */
/* ========================================================================== */
static void disconnected(struct bt_conn *conn, uint8_t reason)
{
    char addr[BT_ADDR_LE_STR_LEN];
    bt_addr_le_to_str(bt_conn_get_dst(conn), addr, sizeof(addr));
    printk("[WARN] Disconnected: %s, reason 0x%02x %s\n", addr, reason, bt_hci_err_to_str(reason));

    if (mobile_connection != conn) {
        return;
    }

    bt_conn_unref(mobile_connection);
    mobile_connection = NULL;

    if (atomic_get(&intentional_disconnect)) {
        atomic_clear(&intentional_disconnect);
        printk("[WARN] Intentional disconnect, not reconnecting.\n");
        return;
    }

    if (start_scan() < 0) {
        printk("[ERROR] Failed to resume scanning\n");
    }
}

/* ========================================================================== */
/* Register connection callbacks with the BT stack                            */
/* ========================================================================== */
BT_CONN_CB_DEFINE(conn_callbacks) = {
    .connected = connected,
    .disconnected = disconnected,
    .le_data_len_updated = on_le_data_len_updated,
};

/* Unsubscribe and close the Gatt connection. Clean-up done in disconnect callback function */
int close_connection(void)
{
    if (mobile_connection == NULL) {
        return (0);
    }

    atomic_set(&intentional_disconnect, 1);
    bt_gatt_unsubscribe(mobile_connection, &subscribe_params);
    int err = bt_conn_disconnect(mobile_connection, BT_HCI_ERR_REMOTE_USER_TERM_CONN);
    if (err) {
        printk("[ERROR] Disconnect failed (err %d)", err);
        atomic_clear(&intentional_disconnect);
        return (err);
    }

    return (0);
}
```

## src/base_gatt.h
```c
/*
 * Copyright (c) 2026 Jack Cairns, Eden Mehr
 *
 * SPDX-License-Identifier: Apache-2.0
 */

#ifndef BASE_GATT_H
#define BASE_GATT_H

#include "zephyr/kernel.h"

int start_scan(void);
int close_connection(void);

/* Message Queue containing recieved data */
extern struct k_msgq ibeacon_msg_queue;

#endif
```

## src/ble_shell.c
```c
/*
 * Copyright (c) 2026 Jack Cairns, Eden Mehr
 *
 * SPDX-License-Identifier: Apache-2.0
 */

#include "ble_shell.h"
#include "json.h"
#include "observer.h"
#include "base_gatt.h"
#include "rb_tree.h"

#include <stdbool.h>
#include <stddef.h>
#include <stdint.h>
#include <stdlib.h>
#include <sys/errno.h>

#include <zephyr/bluetooth/bluetooth.h>

/* ========================================================================== */
/* Compile-time Dispatch / Print Abstraction                                  */
/* CMD_ARGS, CMD_PRINT, CMD_WARN, CMD_ERR expand differently depending on     */
/* whether UART_USB_C is defined. In UART mode the shell handle is dropped    */
/* and output goes via printk. In shell mode the Zephyr shell API is used.    */
/* ========================================================================== */

#ifdef UART_USB_C
#define CMD_ARGS            size_t argc, char **argv
#define CMD_PRINT(fmt, ...) printk(fmt "\n", ##__VA_ARGS__)
#define CMD_WARN(fmt, ...)  printk("[WARN] " fmt "\n", ##__VA_ARGS__)
#define CMD_ERR(fmt, ...)   printk("[ERR] " fmt "\n", ##__VA_ARGS__)
#else
#include <zephyr/shell/shell.h>
#define CMD_ARGS            const struct shell *sh, size_t argc, char **argv
#define CMD_PRINT(fmt, ...) shell_print(sh, fmt "\n", ##__VA_ARGS__)
#define CMD_WARN(fmt, ...)  shell_warn(sh, fmt "\n", ##__VA_ARGS__)
#define CMD_ERR(fmt, ...)   shell_error(sh, fmt "\n", ##__VA_ARGS__)
#endif

/* ========================================================================== */
/* Forward Declarations                                                       */
/* ========================================================================== */

typedef int (*shell_fn_t)(CMD_ARGS);

struct cmd_entry {
    const char *cmd;
    const char *sub;
    shell_fn_t handler;
};

static int cmd_listen_ble_start(CMD_ARGS);
static int cmd_listen_ble_stop(CMD_ARGS);
static int cmd_iBeacon_insert(CMD_ARGS);
static int cmd_iBeacon_remove(CMD_ARGS);
static int cmd_iBeacon_view(CMD_ARGS);

/* ========================================================================== */
/* Control State                                                              */
/* ========================================================================== */

static bool isListening = false;
static bool treeInitialised = false;
atomic_t mode = ATOMIC_INIT(0);

/* ========================================================================== */
/* Dispatch Table                                                             */
/* Maps (cmd, sub) string pairs to handler functions. Used by shell_dispatch  */
/* to route decoded JSON commands from the UART thread to the correct handler.*/
/* ========================================================================== */

/* clang-format off */
// Shell command dispatch table
static const struct cmd_entry shell_dispatch_table[] = {
    {"ble",         "start",    cmd_listen_ble_start},
    {"ble",         "stop",     cmd_listen_ble_stop},
    {"iBeacon",     "view",     cmd_iBeacon_view},
    {"iBeacon",     "add",      cmd_iBeacon_insert},
    {"iBeacon",     "delete",   cmd_iBeacon_remove}
};
/* clang-format on */

/* ========================================================================== */
/* BLE Listen Commands                                                        */
/* ========================================================================== */

/* Listen Start command */
static int cmd_listen_ble_start(CMD_ARGS)
{
    if (isListening) {
        CMD_WARN("Already listening");
        return (-EALREADY);
    }

    int err = close_connection();
    if (err < 0) {
        CMD_WARN("Gatt close failed, Not listening yet, try again");
        return (err);
    }

    // Might be scaning from boot, stop that here.
    bt_le_scan_stop();

    err = observer_start();
    if (err < 0) {
        CMD_WARN("Failed to start listening");
        return (err);
    }

    isListening = true;
    atomic_set(&mode, LISTEN_MODE);
    k_msgq_purge(&ibeacon_msg_queue);
    return (0);
}

/* Listen Stop command */
static int cmd_listen_ble_stop(CMD_ARGS)
{
    if (!isListening) {
        CMD_WARN("Not currently listening");
        return (-EALREADY);
    }

    int ret = observer_stop();
    if (ret < 0) {
        CMD_WARN("Failed to stop listening");
        return (ret);
    }

    isListening = false;
    atomic_set(&mode, STANDARD_MODE);
    k_msgq_purge(&ibeacon_msg_queue);
    start_scan();
    return (0);
}

/* ========================================================================== */
/* iBeacon Tree Commands                                                      */
/* ========================================================================== */

/* Insert into the rbTree a new iBeacon Node */
static int cmd_iBeacon_insert(CMD_ARGS)
{
    if (!treeInitialised) {
        init_rb_tree();
        treeInitialised = true;
    }

    char *name = argv[1];
    char *left = argv[8];
    char *right = argv[9];
    int err = 0;
    uint8_t mac[6];
    uint16_t major, minor;
    double x, y;
    int8_t cali;

    char *end;
    for (uint8_t i = 0; i < 6; i++) {
        mac[i] = (uint8_t)strtol(argv[2], &end, 16);
        if (end == argv[2] || (i < 5 && *end != ':')) {
            // Nothing happened | mising a ':'
            err = (-EINVAL);
            goto invalid_param;
        }

        // Skip ':'
        argv[2] = end + 1;
    }

    major = (uint16_t)strtol(argv[3], &end, 16);
    if (end == argv[3] || *end != '\0' || major == 0) {
        goto invalid_param;
    }

    minor = (uint16_t)strtol(argv[4], &end, 16);
    if (end == argv[4] || *end != '\0' || minor == 0) {
        goto invalid_param;
    }

    x = strtod(argv[5], &end);
    if (*end != '\0' || x < 0) {
        goto invalid_param;
    }

    y = strtod(argv[6], &end);
    if (*end != '\0' || y < 0) {
        goto invalid_param;
    }

    cali = (int8_t)strtol(argv[7], &end, 10);
    if (end == argv[7] || *end != '\0') {
        goto invalid_param;
    }

    CMD_PRINT("Valid params entered, attempting to add");

    err = insert_rb_node(name, mac, major, minor, x, y, cali, left, right);
    if (err < 0) {
        goto fail_insert;
    }

    return (0);

invalid_param:
    CMD_WARN("Invalid params entered");
fail_insert:
    CMD_WARN("Node insert failed, err %d", err);

    return (err);
}

/* Remove from the rbTree an iBeacon Node */
static int cmd_iBeacon_remove(CMD_ARGS)
{
    if (!treeInitialised) {
        init_rb_tree();
        treeInitialised = true;
    }

    char *end;
    char *name = argv[1];
    uint16_t major;
    uint16_t minor;

    major = (uint16_t)strtol(argv[2], &end, 16);
    if (end == argv[2] || *end != '\0' || major == 0) {
        goto invalid_param;
    }

    minor = (uint16_t)strtol(argv[3], &end, 16);
    if (end == argv[3] || *end != '\0' || major == 0) {
        goto invalid_param;
    }

    int err = remove_rb_node(name, major, minor);
    if (err < 0) {
        CMD_WARN("Node didn't exist");
        return (err);
    }

    return 0;

invalid_param:
    CMD_WARN("Invalid params entered");
    return (-EINVAL);
}

/* View an iBeacon or all Nodes from the rbTree */
static int cmd_iBeacon_view(CMD_ARGS)
{
    if (!treeInitialised) {
        init_rb_tree();
        treeInitialised = true;
    }

    char *opt = argv[1];

    if (!strcmp(opt, "-a")) {
        print_rb_node(NULL, true);
    } else {
        print_rb_node(opt, false);
    }

    return (0);
}

/* ========================================================================== */
/* UART Dispatch                                                              */
/* Called by the UART thread after JSON decode. Walks the dispatch table and  */
/* calls the matching handler with the reconstructed argc/argv.               */
/* ========================================================================== */

int shell_dispatch(size_t argc, char **argv, struct cmd_json *cmd)
{
    for (int i = 0; i < ARRAY_SIZE(shell_dispatch_table); i++) {
        if (strcmp(shell_dispatch_table[i].cmd, cmd->cmd) == 0 &&
            strcmp(shell_dispatch_table[i].sub, cmd->sub) == 0) {

            shell_dispatch_table[i].handler(argc, argv);
            return (0);
        }
    }

    // Command not Found
    return (-ESRCH);
}

/* ========================================================================== */
/* Zephyr Shell Registration                                                  */
/* Only compiled in when UART_USB_C is not defined.                           */
/* ========================================================================== */

/* clang-format off */
#ifndef UART_USB_C
SHELL_STATIC_SUBCMD_SET_CREATE(
    listen,
    SHELL_CMD_ARG(start, NULL,
                "Start listening\n"
                "Usage: ble listen start",
                cmd_listen_ble_start, 1, 0),
    SHELL_CMD_ARG(stop, NULL,
                "Stop listening\n"
                "Usage: ble listen stop",
                cmd_listen_ble_stop, 1, 0),
    SHELL_SUBCMD_SET_END
);

SHELL_STATIC_SUBCMD_SET_CREATE(
    ble_cmds,
    SHELL_CMD(listen, &listen, "Listen commands", NULL),
    SHELL_SUBCMD_SET_END
);

SHELL_STATIC_SUBCMD_SET_CREATE(
    iBeacon_cmds,
    SHELL_CMD_ARG(add, NULL,
            "Add an iBeacon Node\n"
            "Name lengths longer than 9 are truncated\n"
            "Usage: iBeacon add <name> <mac> <major> <minor> <x> <y> <cali> <left> <right>",
            cmd_iBeacon_insert, 10, 0),
    SHELL_CMD_ARG(delete, NULL,
            "Remove an iBeacon Node\n"
            "Usage: iBeacon delete <name> <major> <minor>",
            cmd_iBeacon_remove, 4, 0),
    SHELL_CMD_ARG(view, NULL,
            "View an iBeacon Node or -a to view all nodes\n"
            "Usage: iBeacon view <-a | name>",
            cmd_iBeacon_view, 2, 0),
    SHELL_SUBCMD_SET_END
);

SHELL_CMD_REGISTER(ble, &ble_cmds, "ble Commands", NULL);
SHELL_CMD_REGISTER(iBeacon, &iBeacon_cmds, "iBeacon Commands", NULL);
#endif
/* clang-format on */
```

## src/ble_shell.h
```c
/*
 * Copyright (c) 2026 Jack Cairns, Eden Mehr
 *
 * SPDX-License-Identifier: Apache-2.0
 */

#ifndef BLE_SHELL_H
#define BLE_SHELL_H
#include "uart.h" // <- UART_USB_C
#include "json.h"
#include "zephyr/sys/atomic.h"

enum mode_t {
    STANDARD_MODE,
    LISTEN_MODE
};

#ifdef UART_USB_C
int shell_dispatch(size_t argc, char **argv, struct cmd_json *cmd);
#endif

// 1 for base is listen mode, 0 for normal mode
extern atomic_t mode;

#endif
```

## src/json.c
```c
/*
 * Copyright (c) 2026 Jack Cairns, Eden Mehr
 *
 * SPDX-License-Identifier: Apache-2.0
 */

#include "json.h"
#include "zephyr/data/json.h"
#include <sys/errno.h>

/* ========================================================================== */
/* Command Descriptor                                                         */
/* Describes the cmd_json struct layout for the Zephyr JSON codec.            */
/* Used for both encoding outgoing commands and decoding incoming ones.       */
/*                                                                            */
/* Wire format:                                                               */
/*   {"cmd":"<cmd>","sub":"<sub>","opts":["<opt0>","<opt1>", ...]}            */
/* ========================================================================== */

static const struct json_obj_descr cmd_descr[] = {
    JSON_OBJ_DESCR_PRIM(struct cmd_json, cmd, JSON_TOK_STRING),
    JSON_OBJ_DESCR_PRIM(struct cmd_json, sub, JSON_TOK_STRING),
    JSON_OBJ_DESCR_ARRAY(struct cmd_json, opts, MAX_CMD_OPTS, len, JSON_TOK_STRING),
};

/* ========================================================================== */
/* iBeacon Descriptor                                                         */
/* Describes the beacon_json struct layout for the Zephyr JSON codec.         */
/* Used only for encoding outgoing iBeacon packets in LISTEN mode.            */
/*                                                                            */
/* Wire format:                                                               */
/*   {"cmd":"found","name":"<n>","major":"0xXXXX","minor":"0xXXXX",         */
/*    "addr":"<addr>","rssi":"<rssi>"}                                        */
/* ========================================================================== */

static const struct json_obj_descr beacon_descr[] = {
    JSON_OBJ_DESCR_PRIM(struct beacon_json, cmd, JSON_TOK_STRING),
    JSON_OBJ_DESCR_PRIM(struct beacon_json, name, JSON_TOK_STRING),
    JSON_OBJ_DESCR_PRIM(struct beacon_json, major, JSON_TOK_STRING),
    JSON_OBJ_DESCR_PRIM(struct beacon_json, minor, JSON_TOK_STRING),
    JSON_OBJ_DESCR_PRIM(struct beacon_json, addr, JSON_TOK_STRING),
    JSON_OBJ_DESCR_PRIM(struct beacon_json, rssi, JSON_TOK_STRING)};

/* ========================================================================== */
/* Encode / Decode                                                            */
/* ========================================================================== */

/* Encodes a beacon_json struct into a JSON string in the provided buffer. */
int encode_json_beacon(struct beacon_json *val, char *buffer, size_t buf_size)
{
    // buffer needs to be big enough to house the json string
    int ret = json_obj_encode_buf(beacon_descr, ARRAY_SIZE(beacon_descr), val, buffer, buf_size);
    if (ret < 0) {
        return (ret);
    }

    return (0);
}

/* Encodes a cmd_json struct into a JSON string in the provided buffer. */
int encode_json_cmd(struct cmd_json *val, char *buffer, size_t buf_size)
{
    // examples:
    // {"cmd":"pos","sub":"raw","opts":["x", "y", "time"]}
    // {"cmd":"pos","sub":"kalman","opts":["x","y", "time"]}
    // buffer needs to be big enough to house the json string
    int ret = json_obj_encode_buf(cmd_descr, ARRAY_SIZE(cmd_descr), val, buffer, buf_size);
    if (ret < 0) {
        return (ret);
    }

    return (0);
}

/* Decodes a JSON string into a cmd_json struct. */
int decode_json_cmd(char *input, struct cmd_json *data)
{
    /* The input string is modified in place by the Zephyr JSON parser. */
    /* Pointers in the output struct point into the input buffer.       */
    /* Do not free or overwrite input while the struct is still in use. */

    // examples:
    // {"cmd":"iBeacon","sub":"delete","opts":["<name>"]}
    // {"cmd":"iBeacon","sub":"add","opts":["<name>", ...]}
    // {"cmd":"iBeacon","sub":"view","opts":["-a"]}
    // {"cmd":"iBeacon","sub":"view","opts":["4011-B"]}
    // {"cmd":"ble","sub":"start","opts":[]}
    // {"cmd":"ble","sub":"stop","opts":[]}
    int ret = json_obj_parse(input, strlen(input), cmd_descr, ARRAY_SIZE(cmd_descr), data);
    if (ret < 0) {
        return (ret);
    }

    return (0);
}
```

## src/json.h
```c
/*
 * Copyright (c) 2026 Jack Cairns, Eden Mehr
 *
 * SPDX-License-Identifier: Apache-2.0
 */

#ifndef JSON_H
#define JSON_H

#include <stddef.h>
#include <zephyr/data/json.h>

#define MAX_CMD_OPTS 26 // iBeacon add ... is longest cmd

struct cmd_json {
    char *cmd;                // "pos", "view", "ble", "iBeacon"
    char *sub;                // "add", "delete", "start", "end", "node", "stop"
    char *opts[MAX_CMD_OPTS]; // options need for sub
    size_t len;
};

struct beacon_json {
    char *cmd;   // "found"
    char *name;  // beacon name
    char *major; // and so on...
    char *minor;
    char *addr;
    char *rssi;
};

int encode_json_beacon(struct beacon_json *val, char *buffer, size_t buf_size);
int encode_json_cmd(struct cmd_json *val, char *buffer, size_t buf_size);
int decode_json_cmd(char *input, struct cmd_json *data);

#endif
```

## src/kalman.c
```c
/*
 * Copyright (c) 2026 Jack Cairns, Eden Mehr
 *
 * SPDX-License-Identifier: Apache-2.0
 */

#include "kalman.h"
#include "matrix.h"
#include "localisation.h"

#include "zephyr/kernel.h"
#include "zephyr/toolchain.h"
#include <stdint.h>
#include <stdio.h>
#include <math.h>

K_MSGQ_DEFINE(kalman_msg_queue, sizeof(struct all_position), 5, 4);

/* ========================================================================== */
/* Filter State                                                               */
/* Static instance of the 2D Kalman filter. Matrices are zero-initialised     */
/* here; kf_init() fills in the correct values before the thread runs.        */
/* F and H are set to identity/observation defaults; Q, R, P are zeroed       */
/* and populated at runtime to allow variable-dt updates.                     */
/* ========================================================================== */

/* clang-format off */
struct kalman_filter_2D filter = {
    .F = {
        {1, 0, 0, 0},
        {0, 1, 0, 0},
        {0, 0, 1, 0},
        {0, 0, 0, 1}},
    .H = {
        {1, 0, 0, 0},
        {0, 1, 0, 0}},
    .Q = {
        {0, 0, 0, 0},
        {0, 0, 0, 0},
        {0, 0, 0, 0},
        {0, 0, 0, 0}},
    .R = {
        {0, 0},
        {0, 0}},
    .P = {
        {0, 0, 0, 0},
        {0, 0, 0, 0},
        {0, 0, 0, 0},
        {0, 0, 0, 0}},
    .x = {
        {0}, {0}, {0}, {0}}
};

/* Identity matrix reused in the covariance update step: P = (I - KH) * P */
double identity[NUM_STATES][NUM_STATES] = {
    {1, 0, 0, 0},
    {0, 1, 0, 0},
    {0, 0, 1, 0},
    {0, 0, 0, 1}
};
/* clang-format on */

/* ========================================================================== */
/* INITIALISATION                                                             */
/* Sets up F, Q, R, and P using the default DT defined in kalman.h.           */
/* Called once before the filter loop starts. F and Q will be rebuilt each    */
/* cycle by kf_update_dt() using the actual measured dt.                      */
/*                                                                            */
/* Tuning knobs (defined in kalman.h):                                        */
/*   Q_VAR - process noise variance. Increase if output lags real position.   */
/*   R_VAR - measurement noise variance. Increase if output is too noisy.     */
/*   P0    - initial state covariance diagonal. Decrease for faster           */
/*           convergence at startup.                                          */
/* ========================================================================== */

void kf_init(struct kalman_filter_2D *kf)
{
    double dt = DT;
    double dt2 = pow(DT, 2);
    double dt3 = pow(DT, 3);
    double dt4 = pow(DT, 4);

    /* State transition matrix F: constant-velocity model */
    /* x_k = x_{k-1} + vx*dt,  y_k = y_{k-1} + vy*dt      */
    kf->F[0][2] = dt;
    kf->F[1][3] = dt;

    /* Process noise covariance Q: derived from continuous white noise */
    /* acceleration model, discretised over dt.                        */
    kf->Q[0][0] = dt4 / 4 * Q_VAR;
    kf->Q[0][2] = dt3 / 2 * Q_VAR;
    kf->Q[1][1] = dt4 / 4 * Q_VAR;
    kf->Q[1][3] = dt3 / 2 * Q_VAR;
    kf->Q[2][0] = dt3 / 2 * Q_VAR;
    kf->Q[2][2] = dt2 * Q_VAR;
    kf->Q[3][1] = dt3 / 2 * Q_VAR;
    kf->Q[3][3] = dt2 * Q_VAR;

    /* Measurement noise covariance R: assumed diagonal (x and y */
    /* measurement errors are independent).                      */
    kf->R[0][0] = R_VAR;
    kf->R[1][1] = R_VAR;

    /* Initial state covariance P: diagonal with P0, reflecting high */
    /* initial uncertainty in both position and velocity states.     */
    for (uint8_t i = 0; i < NUM_STATES; i++) {
        for (uint8_t j = 0; j < NUM_STATES; j++) {
            kf->P[i][j] = (i == j) ? P0 : 0.0;
        }
    }
}

/* ========================================================================== */
/* UPDATE DT                                                                  */
/* Rebuilds F and Q for the actual elapsed time since the last measurement.   */
/* Must be called before kf_predict() each cycle so the motion model and      */
/* process noise correctly reflect the real sample interval rather than the   */
/* fixed DT fallback.                                                         */
/* ========================================================================== */

static void kf_update_dt(struct kalman_filter_2D *kf, double dt)
{
    double dt2 = dt * dt;
    double dt3 = dt2 * dt;
    double dt4 = dt3 * dt;

    /* Rebuild state transition matrix with new dt */
    kf->F[0][2] = dt;
    kf->F[1][3] = dt;

    /* Rebuild process noise covariance with new dt */
    kf->Q[0][0] = dt4 / 4 * Q_VAR;
    kf->Q[0][2] = dt3 / 2 * Q_VAR;
    kf->Q[1][1] = dt4 / 4 * Q_VAR;
    kf->Q[1][3] = dt3 / 2 * Q_VAR;
    kf->Q[2][0] = dt3 / 2 * Q_VAR;
    kf->Q[2][2] = dt2 * Q_VAR;
    kf->Q[3][1] = dt3 / 2 * Q_VAR;
    kf->Q[3][3] = dt2 * Q_VAR;
}

/* ========================================================================== */
/* PREDICT STEP                                                               */
/* Projects the state and covariance forward one timestep using the motion    */
/* model F and process noise Q.                                               */
/*                                                                            */
/*   x = F * x                                                                */
/*   P = F * P * F^T + Q                                                      */
/* ========================================================================== */

static void kf_predict(struct kalman_filter_2D *kf)
{
    /* x = F * x */
    matrix_multi(&(kf->F[0][0]), &(kf->x[0][0]), &(kf->x_prior[0][0]), NUM_STATES, NUM_STATES, 1);

    /* P = F * P * F^T + Q */
    double Ft[NUM_STATES][NUM_STATES];
    matrix_trans(&(kf->F[0][0]), &(Ft[0][0]), NUM_STATES, NUM_STATES);

    double FP[NUM_STATES][NUM_STATES];
    matrix_multi(&(kf->F[0][0]), &(kf->P[0][0]), &(FP[0][0]), NUM_STATES, NUM_STATES, NUM_STATES);

    double FPFt[NUM_STATES][NUM_STATES];
    matrix_multi(&(FP[0][0]), &(Ft[0][0]), &(FPFt[0][0]), NUM_STATES, NUM_STATES, NUM_STATES);

    matrix_add(&(FPFt[0][0]), &(kf->Q[0][0]), &(kf->P_prior[0][0]), NUM_STATES, NUM_STATES);

    /* Commit predicted state and covariance */
    matrix_copy(&(kf->x_prior[0][0]), &(kf->x[0][0]), NUM_STATES, 1);
    matrix_copy(&(kf->P_prior[0][0]), &(kf->P[0][0]), NUM_STATES, NUM_STATES);
}

/* ========================================================================== */
/* UPDATE STEP                                                                */
/* Corrects the predicted state using the new position measurement z.         */
/*                                                                            */
/*   y = z - H * x              (innovation)                                  */
/*   S = H * P * H^T + R        (innovation covariance)                       */
/*   K = P * H^T * S^-1         (Kalman gain)                                 */
/*   x = x + K * y              (state update)                                */
/*   P = (I - K * H) * P        (covariance update)                           */
/*                                                                            */
/* Returns -EINVAL if S is singular (measurement is discarded).               */
/* ========================================================================== */

static int kf_update(struct kalman_filter_2D *kf, double z[NUM_MEAS][1])
{
    int err;

    /* y = z - H * x */
    double Hx[NUM_MEAS][1];
    matrix_multi(&(kf->H[0][0]), &(kf->x[0][0]), &(Hx[0][0]), NUM_MEAS, NUM_STATES, 1);

    double y[NUM_MEAS][1];
    matrix_sub(&(z[0][0]), &(Hx[0][0]), &(y[0][0]), NUM_MEAS, 1);

    /* S = H * P * H^T + R */
    double Ht[NUM_STATES][NUM_MEAS];
    matrix_trans(&(kf->H[0][0]), &(Ht[0][0]), NUM_MEAS, NUM_STATES);

    double HP[NUM_MEAS][NUM_STATES];
    matrix_multi(&(kf->H[0][0]), &(kf->P[0][0]), &(HP[0][0]), NUM_MEAS, NUM_STATES, NUM_STATES);

    double S[NUM_MEAS][NUM_MEAS];
    matrix_multi(&(HP[0][0]), &(Ht[0][0]), &(S[0][0]), NUM_MEAS, NUM_STATES, NUM_MEAS);
    matrix_add(&(S[0][0]), &(kf->R[0][0]), &(S[0][0]), NUM_MEAS, NUM_MEAS);

    /* K = P * H^T * S^-1 */
    double S_inv[NUM_MEAS][NUM_MEAS];
    err = matrix2x2_inv(S, S_inv);
    if (err) {
        return (err);
    }

    double PHt[NUM_STATES][NUM_MEAS];
    matrix_multi(&(kf->P[0][0]), &(Ht[0][0]), &(PHt[0][0]), NUM_STATES, NUM_STATES, NUM_MEAS);
    matrix_multi(&(PHt[0][0]), &(S_inv[0][0]), &(kf->K[0][0]), NUM_STATES, NUM_MEAS, NUM_MEAS);

    /* x = x + K * y */
    double Ky[NUM_STATES][1];
    matrix_multi(&(kf->K[0][0]), &(y[0][0]), &(Ky[0][0]), NUM_STATES, NUM_MEAS, 1);
    matrix_add(&(kf->x[0][0]), &(Ky[0][0]), &(kf->x[0][0]), NUM_STATES, 1);

    /* P = (I - K * H) * P */
    double KH[NUM_STATES][NUM_STATES];
    matrix_multi(&(kf->K[0][0]), &(kf->H[0][0]), &(KH[0][0]), NUM_STATES, NUM_MEAS, NUM_STATES);

    double I_KH[NUM_STATES][NUM_STATES];
    matrix_sub(&(identity[0][0]), &(KH[0][0]), &(I_KH[0][0]), NUM_STATES, NUM_STATES);
    matrix_multi(&(I_KH[0][0]), &(kf->P[0][0]), &(kf->P[0][0]), NUM_STATES, NUM_STATES, NUM_STATES);

    return (0);
}

/* ========================================================================== */
/* KALMAN THREAD                                                              */
/* Consumes raw position fixes from localisation_msg_queue, runs one          */
/* predict-update cycle per fix, and pushes both the raw and filtered         */
/* positions onto kalman_msg_queue for the UART thread to transmit.           */
/*                                                                            */
/* dt is computed from the timestamp embedded in each position_data struct    */
/* rather than assuming a fixed interval. It is clamped to [0.05, 2.0]s to    */
/* prevent corruption from localisation stalls or burst catch-up.             */
/* ========================================================================== */

void thread_kalman(void *dummy1, void *dummy2, void *dummy3)
{
    ARG_UNUSED(dummy1);
    ARG_UNUSED(dummy2);
    ARG_UNUSED(dummy3);

    struct position_data raw = {0};
    struct kalman_position kalman = {0};
    struct all_position msg = {0};
    double raw_pos[NUM_MEAS][1] = {0};

    int64_t last_time = 0;

    kf_init(&filter);

    while (1) {

        /* Block until a new position fix is available */
        k_msgq_get(&localisation_msg_queue, &raw, K_FOREVER);

        /* Compute actual dt from localisation timestamps */
        double dt;
        if (last_time == 0) {
            dt = DT; /* fallback for the very first measurement */
        } else {
            dt = (double)(raw.timestamp - last_time) / 1000.0;

            /* Clamp dt - a stall followed by burst catch-up would otherwise */
            /* cause an implausibly large state prediction jump              */
            if (dt > 2.0) {
                dt = 2.0;
            } else if (dt < 0.05) {
                dt = 0.05;
            }
        }

        last_time = raw.timestamp;

        raw_pos[0][0] = raw.x;
        raw_pos[1][0] = raw.y;

        /* Rebuild F and Q for this dt before predicting */
        kf_update_dt(&filter, dt);

        /* Predict then correct */
        kf_predict(&filter);
        if (kf_update(&filter, raw_pos) < 0) {
            // Singular matrix found -> discard this measurment
            continue;
        }

        /* store kalman output */
        kalman.x = filter.x[0][0];
        kalman.y = filter.x[1][0];
        kalman.timestamp = k_uptime_get();

        /* Forward both raw and kalman positions to the UART thread */
        msg.raw = raw;
        msg.kalman = kalman;
        k_msgq_put(&kalman_msg_queue, &msg, K_NO_WAIT);
    }
}

K_THREAD_DEFINE(kalman_thread, 8192, thread_kalman, NULL, NULL, NULL, 7, 0, 0);
```

## src/kalman.h
```c
/*
 * Copyright (c) 2026 Jack Cairns, Eden Mehr
 *
 * SPDX-License-Identifier: Apache-2.0
 */

#ifndef KALMAN_H
#define KALMAN_H

#include "localisation.h"

#define DT         0.5 // default fallback
#define NUM_STATES 4
#define NUM_MEAS   2

// Tuning Constants

/*
 -  R_VAR: how much you trust the multilateration output. Higher = filter trusts its own prediction
    more and smooths out measurement noise, but lags real movement.
 -  Q_VAR: how much you trust the motion model. Higher = filter responds faster to real movement,
    but passes through more noise.
 -  P0: just affects how quickly the filter converges from startup, not steady-state behaviour.
*/

#define R_VAR 50.0
#define Q_VAR 45.0
#define P0    5.0

/* Message Queue containing positional data */
extern struct k_msgq kalman_msg_queue;

struct kalman_position {
    int64_t timestamp;
    double x;
    double y;
};

struct all_position {
    struct position_data raw;
    struct kalman_position kalman;
};

struct kalman_filter_2D {
    double F[NUM_STATES][NUM_STATES]; /* state transition matrix*/
    double H[NUM_MEAS][NUM_STATES];
    double Q[NUM_STATES][NUM_STATES];
    double R[NUM_MEAS][NUM_MEAS];
    double P[NUM_STATES][NUM_STATES];
    double x[NUM_STATES][1];

    double x_prior[NUM_STATES][1];
    double P_prior[NUM_STATES][NUM_STATES];
    double K[NUM_STATES][NUM_MEAS];
};

#endif /* KALMAN_H */
```
